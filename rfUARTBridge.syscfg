/**
 * These arguments were used when this file was generated. They will be automatically applied on subsequent loads
 * via the GUI or CLI. Run CLI with '--help' for additional information on how to override these arguments.
 * @cliArgs --board "/ti/boards/LP_EM_CC1314R10" --rtos "nortos" --product "simplelink_cc13xx_cc26xx_sdk@7.41.00.17"
 * @versions {"tool":"1.18.1+3343"}
 */

/**
 * Import the modules used in this configuration.
 */
const CCFG     = scripting.addModule("/ti/devices/CCFG");
const custom   = scripting.addModule("/ti/devices/radioconfig/custom");
const rfdesign = scripting.addModule("/ti/devices/radioconfig/rfdesign");
const GPIO     = scripting.addModule("/ti/drivers/GPIO");
const GPIO1    = GPIO.addInstance();
const GPIO2    = GPIO.addInstance();
const GPIO3    = GPIO.addInstance();
const GPIO4    = GPIO.addInstance();
const GPIO5    = GPIO.addInstance();
const GPIO6    = GPIO.addInstance();
const GPIO7    = GPIO.addInstance();
const GPIO8    = GPIO.addInstance();
const GPIO9    = GPIO.addInstance();
const I2C      = scripting.addModule("/ti/drivers/I2C", {}, false);
const I2C1     = I2C.addInstance();
const NVS      = scripting.addModule("/ti/drivers/NVS", {}, false);
const NVS1     = NVS.addInstance();
const RF       = scripting.addModule("/ti/drivers/RF");
const SPI      = scripting.addModule("/ti/drivers/SPI", {}, false);
const SPI1     = SPI.addInstance();
const Timer    = scripting.addModule("/ti/drivers/Timer", {}, false);
const Timer1   = Timer.addInstance();
const UART2    = scripting.addModule("/ti/drivers/UART2");
const UART21   = UART2.addInstance();
const UART22   = UART2.addInstance();

/**
 * Write custom configuration values to the imported modules.
 */
CCFG.xoscCapArray             = true;
CCFG.xoscCapArrayDelta        = 0xD5;
CCFG.enableBootloader         = true;
CCFG.levelBootloaderBackdoor  = "Active low";
CCFG.enableBootloaderBackdoor = true;
CCFG.dioBootloaderBackdoor    = 13;
CCFG.ccfgTemplate.$name       = "ti_devices_CCFG_CCFGCC26XXTemplate0";

custom.prop8                                                = ["2gfsk50kbps"];
custom.radioConfig2gfsk50kbps.$name                         = "ti_devices_radioconfig_settings_prop0";
custom.radioConfig2gfsk50kbps.carrierFrequency              = 868.0000;
custom.radioConfig2gfsk50kbps.symbolRate                    = 1000.000;
custom.radioConfig2gfsk50kbps.deviation                     = 350.0;
custom.radioConfig2gfsk50kbps.rxFilterBw                    = "2185.1";
custom.radioConfig2gfsk50kbps.txPower                       = "12";
custom.radioConfig2gfsk50kbps.whitening                     = "PN9 Whitening";
custom.radioConfig2gfsk50kbps.codeExportConfig.$name        = "ti_devices_radioconfig_code_export_param0";
custom.radioConfig2gfsk50kbps.codeExportConfig.symGenMethod = "Legacy";

rfdesign.rfDesign = "LP_EM_CC1314R10";

GPIO1.$hardware = system.deviceData.board.components.LED_RED;
GPIO1.$name     = "CONFIG_GPIO_RLED";

GPIO2.$hardware = system.deviceData.board.components.LED_GREEN;
GPIO2.$name     = "CONFIG_GPIO_GLED";

GPIO3.$name           = "SPICS";
GPIO3.mode            = "Output";
GPIO3.gpioPin.$assign = "boosterpack.24";

GPIO4.$name           = "LNA_HIGH";
GPIO4.mode            = "Output";
GPIO4.gpioPin.$assign = "boosterpack.28";

GPIO5.$name           = "PA_HIGH";
GPIO5.mode            = "Output";
GPIO5.gpioPin.$assign = "boosterpack.27";

GPIO6.$name           = "TX_HIGH";
GPIO6.mode            = "Output";
GPIO6.gpioPin.$assign = "boosterpack.26";

GPIO7.pull             = "Pull Up";
GPIO7.interruptTrigger = "Falling Edge";
GPIO7.$name            = "EINT";
GPIO7.gpioPin.$assign  = "boosterpack.25";

GPIO8.$name           = "sigpin";
GPIO8.mode            = "Output";
GPIO8.gpioPin.$assign = "boosterpack.38";

GPIO9.$name           = "sigpin2";
GPIO9.mode            = "Output";
GPIO9.gpioPin.$assign = "boosterpack.37";

I2C1.$name              = "CONFIG_I2C_0";
I2C1.maxBitRate         = 400;
I2C1.i2c.sdaPin.$assign = "boosterpack.32";
I2C1.i2c.sclPin.$assign = "boosterpack.31";

NVS1.$name               = "CONFIG_INTERNAL";
NVS1.internalFlash.$name = "ti_drivers_nvs_NVSCC26XX0";

SPI1.$name               = "CONFIG_SPI_0";
SPI1.spi.sclkPin.$assign = "boosterpack.2";
SPI1.spi.pociPin.$assign = "boosterpack.6";
SPI1.spi.picoPin.$assign = "boosterpack.23";

Timer1.$name               = "CONFIG_TIMER_0";
Timer1.timerInstance.$name = "CONFIG_GPTIMER_0";

UART21.$name               = "CONFIG_UART2_0";
UART21.$hardware           = system.deviceData.board.components.XDS110UART;
UART21.txPinInstance.$name = "CONFIG_PIN_UART_TX";
UART21.rxPinInstance.$name = "CONFIG_PIN_UART_RX";

UART22.$name = "CONFIG_UART2_1";

/**
 * Pinmux solution for unlocked pins/peripherals. This ensures that minor changes to the automatic solver in a future
 * version of the tool will not impact the pinmux you originally saw.  These lines can be completely deleted in order to
 * re-solve from scratch.
 */
GPIO1.gpioPin.$suggestSolution              = "DIO_6";
GPIO2.gpioPin.$suggestSolution              = "DIO_7";
I2C1.i2c.$suggestSolution                   = "I2C0";
SPI1.spi.$suggestSolution                   = "SPI0";
SPI1.spi.dmaRxChannel.$suggestSolution      = "DMA_CH3";
SPI1.spi.dmaTxChannel.$suggestSolution      = "DMA_CH4";
Timer1.timerInstance.timer.$suggestSolution = "GPTM0";
UART21.uart.$suggestSolution                = "UART1";
UART21.uart.txPin.$suggestSolution          = "boosterpack.4";
UART21.uart.rxPin.$suggestSolution          = "boosterpack.3";
UART22.uart.$suggestSolution                = "UART0";
UART22.uart.txPin.$suggestSolution          = "boosterpack.19";
UART22.uart.rxPin.$suggestSolution          = "boosterpack.39";
